#include<XBee.h>
XBee xbee=XBee();
//byte hola[]={0x6F ,0x6C ,0x20 ,0x6D ,0x75 ,0x6E ,0x64 ,0x6F ,0x17}; // hola mundo
byte large[] = {0x47 ,0x65 ,0x6E ,0x65 ,0x72 ,0x61 ,0x6E ,0x64 ,0x6F ,0x20 ,0x75 ,0x6E ,0x61 ,0x20 ,0x74 ,0x72 ,0x61 ,0x6D ,0x61 ,0x20 ,0x65 ,0x78 ,
                0x63 ,0x65 ,0x73 ,0x69 ,0x76 ,0x61 ,0x6D ,0x65 ,0x6E ,0x74 ,0x65 ,0x20 ,0x6C ,0x61 ,0x72 ,0x67 ,0x61 ,0x20 ,0x73 ,0x69 ,0x6E ,0x67 ,
                0x75 ,0x6E ,0x20 ,0x72 ,0x61 ,0x7A ,0x6F ,0x6E ,0x20 ,0x61 ,0x70 ,0x61 ,0x72 ,0x65 ,0x6E ,0x74 ,0x65 ,0x20 ,0x6D ,0x61 ,0x73 ,0x20 ,
                0x71 ,0x75 ,0x65 ,0x20 ,0x65 ,0x6C ,0x20 ,0x73 ,0x6E ,0x69 ,0x66 ,0x66 ,0x65 ,0x72 ,0x20 ,0x66 ,0x75 ,0x6E ,0x63 ,0x69 ,0x6F ,0x6E ,0x65};
Tx16Request led = Tx16Request(0x0,large,sizeof(led));
TxStatusResponse txStatus = TxStatusResponse();
int pin0=0;
int statusLed=10;
int errorLed=11;
int i=0;
int pin0_hex=0;
int pin33=33;
  
void setup(){
  Serial.begin(9600);
  pinMode(statusLed,OUTPUT);
  pinMode(errorLed, OUTPUT);

  }
void flashLed(int pin, int times) {
    for (int i = 0; i < times; i++) {
      digitalWrite(pin, HIGH);
      digitalWrite(pin, LOW);
    }
}
void loop(){ 
  for(int contador=0;contador<=10000;contador++){
  xbee.send(led);
  if (xbee.readPacket(5000)){
    if (xbee.getResponse().getApiId() == TX_STATUS_RESPONSE){
      xbee.getResponse().getTxStatusResponse(txStatus);
      if (txStatus.getStatus() == SUCCESS){
        flashLed(statusLed,1);
      } else {
        // Este sera el error 01
        flashLed(errorLed,1);
      }
    }
  } else if (xbee.getResponse().isError()){
      //String_error= xbee.getResponse().getErrorCode();
      flashLed(errorLed,1);
      // or flash error led
    } else {
      //Este sera el error 03
      flashLed(errorLed,1);
    }
    // Delay in ms
  //delay(2000);
   }
     
}

